## oe-recipes/meta-onekvm-extension-host/conf/layer.conf
```bitbake
BBPATH .= ":${LAYERDIR}"
BBFILES += "${LAYERDIR}/recipes-*/*/*.bb ${LAYERDIR}/recipes-*/*/*.bbappend"
BBFILE_COLLECTIONS += "onekvm-extension-host"
BBFILE_PATTERN_onekvm-extension-host := "^${LAYERDIR}/"
BBFILE_PRIORITY_onekvm-extension-host = "8"
LAYERDEPENDS_onekvm-extension-host = "core"
LAYERSERIES_COMPAT_onekvm-extension-host = "wrynose"
```
